## Kconfig
```kconfig
#
# For a description of the syntax of this configuration file,
# see the file kconfig-language.txt in the NuttX tools repository.
#

config EXAMPLES_HELLO
	tristate "Projeto"
	default n
	---help---
		Enable the Projeto

if EXAMPLES_HELLO

config EXAMPLES_HELLO_PROGNAME
	string "Program"
	default "oi"
	---help---
		This kk
		program kkk

config EXAMPLES_HELLO_PRIORITY
	int "prioridade"
	default 100

config EXAMPLES_HELLO_STACKSIZE
	int "stack size"
	default DEFAULT_TASK_STACKSIZE

endif
```
